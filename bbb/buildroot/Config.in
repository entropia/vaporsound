## bbb/buildroot/Config.in
```kconfig
source "$BR2_EXTERNAL_Vaporsound_PATH/package/vaporctl/Config.in"
source "$BR2_EXTERNAL_Vaporsound_PATH/package/vaporui/Config.in"
```

## bbb/buildroot/configs/vaporsound_defconfig
```kconfig
# architecture
BR2_arm=y
BR2_cortex_a8=y
BR2_ARM_EABIHF=y

# system
BR2_TARGET_GENERIC_HOSTNAME="vaporsound"
BR2_ROOTFS_DEVICE_CREATION_DYNAMIC_DEVTMPFS=y
BR2_TARGET_GENERIC_GETTY_PORT="ttyO0"
# BR2_TARGET_GENERIC_REMOUNT_ROOTFS_RW is not set
BR2_ROOTFS_POST_IMAGE_SCRIPT="board/vaporsound/post-image.sh"

# filesystem
BR2_PACKAGE_AM33X_CM3=y
BR2_TARGET_ROOTFS_EXT2=y
# BR2_TARGET_ROOTFS_TAR is not set

# lock down headers to avoid breaking with new defaults
BR2_KERNEL_HEADERS_VERSION=y
BR2_DEFAULT_KERNEL_VERSION="3.12.10"
BR2_PACKAGE_HOST_LINUX_HEADERS_CUSTOM_3_12=y

# bootloader
BR2_TARGET_UBOOT=y
BR2_TARGET_UBOOT_BOARDNAME="am335x_evm"
BR2_TARGET_UBOOT_CUSTOM_VERSION=y
BR2_TARGET_UBOOT_CUSTOM_VERSION_VALUE="2013.10"
BR2_TARGET_UBOOT_FORMAT_IMG=y
BR2_TARGET_UBOOT_SPL=y
BR2_TARGET_UBOOT_SPL_NAME="MLO"

# kernel
BR2_LINUX_KERNEL=y
BR2_LINUX_KERNEL_CUSTOM_GIT=y
BR2_LINUX_KERNEL_CUSTOM_REPO_URL="https://github.com/beagleboard/linux"
BR2_LINUX_KERNEL_CUSTOM_REPO_VERSION="d2a105dc8333d93638aae62cc6d0a7d05ded2b38"
BR2_LINUX_KERNEL_PATCH="board/vaporsound/patches/linux/"
BR2_LINUX_KERNEL_USE_CUSTOM_CONFIG=y
BR2_LINUX_KERNEL_CUSTOM_CONFIG_FILE="board/vaporsound/linux-3.12.config"
BR2_LINUX_KERNEL_ZIMAGE=y
BR2_LINUX_KERNEL_DTS_SUPPORT=y
BR2_LINUX_KERNEL_USE_CUSTOM_DTS=y
BR2_LINUX_KERNEL_CUSTOM_DTS_PATH="board/vaporsound/am335x-boneblack-vaporsound.dts"

# userland
BR2_PACKAGE_PULSEAUDIO=y
BR2_PACKAGE_PULSEAUDIO_DAEMON=y
```

## bbb/buildroot/package/ram-overlay/Config.in
```kconfig
config BR2_PACKAGE_VAPORSOUND_RAM_OVERLAY
	bool "Vaporsound RAM overlay tool"
	help
	  This tool mounts a RAM overlay filesystem over the root filesystem
	  to allow it to be made readonly.
```

## bbb/buildroot/package/vaporctl/Config.in
```kconfig
config BR2_PACKAGE_VAPORCTL
	bool "Vaporsound API daemon"
	select BR2_PACKAGE_ALSA_LIB
	select BR2_PACKAGE_LIBMICROHTTPD
	select BR2_PACKAGE_LIBUBOX
	help
	  Vaporsound API daemon
```

## bbb/buildroot/package/vaporui/Config.in
```kconfig
config BR2_PACKAGE_VAPORUI
	bool "Vaporsound UI daemon"
	select BR2_PACKAGE_LIBUBOX
	help
	  Vaporsound UI daemon
```
